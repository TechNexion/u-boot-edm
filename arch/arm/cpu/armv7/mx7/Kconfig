## arch/arm/cpu/armv7/mx7/Kconfig
```kconfig
if ARCH_MX7

config MX7
	bool
	default y

config MX7D
	select ROM_UNIFIED_SECTIONS
	bool

choice
	prompt "MX7 board select"
	optional

config TARGET_MX7DSABRESD
	bool "mx7dsabresd"
	select MX7D
	select DM
	select DM_THERMAL

config TARGET_MX7D_12X12_LPDDR3_ARM2
	bool "mx7d_12x12_lpddr3_arm2"
	select MX7D
	select DM
	select DM_THERMAL

config TARGET_MX7D_12X12_DDR3_ARM2
	bool "mx7d_12x12_ddr3_arm2"
	select MX7D
	select DM
	select DM_THERMAL

config TARGET_MX7D_19X19_LPDDR2_ARM2
	bool "mx7d_19x19_lpddr3_arm2"
	select MX7D
	select DM
	select DM_THERMAL

config TARGET_MX7D_19X19_LPDDR3_ARM2
	bool "mx7d_19x19_lpddr3_arm2"
	select MX7D
	select DM
	select DM_THERMAL

config TARGET_MX7D_19X19_DDR3_ARM2
	bool "mx7d_19x19_ddr3_arm2"
	select MX7D
	select DM
	select DM_THERMAL

config TARGET_PICO_IMX7D
	bool "Support pico-imx7d"
	select CPU_V7
	select SUPPORT_SPL

config TARGET_EDM1_IMX7D
	bool "Support edm1-imx7d"
	select CPU_V7
	select SUPPORT_SPL
endchoice

config SYS_SOC
	default "mx7"

source "board/freescale/mx7dsabresd/Kconfig"
source "board/freescale/mx7d_12x12_lpddr3_arm2/Kconfig"
source "board/freescale/mx7d_12x12_ddr3_arm2/Kconfig"
source "board/freescale/mx7d_19x19_lpddr3_arm2/Kconfig"
source "board/freescale/mx7d_19x19_ddr3_arm2/Kconfig"
source "board/technexion/pico-imx7d/Kconfig"
source "board/technexion/edm1-imx7d/Kconfig"

endif
```

## board/technexion/edm-cf-imx6/tnrescue-imx6dl.its
```
/*
 * U-Boot uImage source file with multiple kernels, ramdisks and FDT blobs
 */

/dts-v1/;

/ {
	description = "Various kernels, ramdisks and FDT blobs";
	#address-cells = <1>;

	images {
		kernel@1 {
			description = "TechNexion IMX6/IMX7 Linux Kernel";
			data = /incbin/("./zImage");
			type = "kernel";
			arch = "arm";
			os = "linux";
			compression = "none";
			load = <0x12000000>;
			entry = <0x12000000>;
			hash@2 {
				algo = "sha1";
			};
		};

		ramdisk@1 {
			description = "TechNexion Rescue/Installer Ramdisk with Qt";
			data = /incbin/("./rootfs.cpio.xz");
			type = "ramdisk";
			arch = "arm";
			os = "linux";
			compression = "none";
			load = <0x12C00000>;
			entry = <0x1B000000>;
			hash@1 {
				algo = "sha1";
			};
		};
		/* imx6dl */
		fdt@17 {
			description = "imx6dl-edm1_fairy";
			data = /incbin/("./dtb/imx6dl-edm1_fairy.dtb");
			type = "flat_dt";
			arch = "arm";
			compression = "none";
			load = <0x12BE0000>;
			hash@1 {
				algo = "sha1";
			};
		};
		fdt@18 {
			description = "imx6dl-edm1_gnome";
			data = /incbin/("./dtb/imx6dl-edm1_gnome.dtb");
			type = "flat_dt";
			arch = "arm";
			compression = "none";
			load = <0x12BE0000>;
			hash@1 {
				algo = "sha1";
			};
		};
		fdt@19 {
			description = "imx6dl-edm1_tc0700";
			data = /incbin/("./dtb/imx6dl-edm1_tc0700.dtb");
			type = "flat_dt";
			arch = "arm";
			compression = "none";
			load = <0x12BE0000>;
			hash@1 {
				algo = "sha1";
			};
		};
		fdt@20 {
			description = "imx6dl-edm1_tc1000";
			data = /incbin/("./dtb/imx6dl-edm1_tc1000.dtb");
			type = "flat_dt";
			arch = "arm";
			compression = "none";
			load = <0x12BE0000>;
			hash@1 {
				algo = "sha1";
			};
		};
		fdt@21 {
			description = "imx6dl-edm1-qca_fairy";
			data = /incbin/("./dtb/imx6dl-edm1-qca_fairy.dtb");
			type = "flat_dt";
			arch = "arm";
			compression = "none";
			load = <0x12BE0000>;
			hash@1 {
				algo = "sha1";
			};
		};
		fdt@22 {
			description = "imx6dl-edm1-qca_gnome";
			data = /incbin/("./dtb/imx6dl-edm1-qca_gnome.dtb");
			type = "flat_dt";
			arch = "arm";
			compression = "none";
			load = <0x12BE0000>;
			hash@1 {
				algo = "sha1";
			};
		};
		fdt@23 {
			description = "imx6dl-edm1-qca_tc0700";
			data = /incbin/("./dtb/imx6dl-edm1-qca_tc0700.dtb");
			type = "flat_dt";
			arch = "arm";
			compression = "none";
			load = <0x12BE0000>;
			hash@1 {
				algo = "sha1";
			};
		};
		fdt@24 {
			description = "imx6dl-edm1-qca_tc1000";
			data = /incbin/("./dtb/imx6dl-edm1-qca_tc1000.dtb");
			type = "flat_dt";
			arch = "arm";
			compression = "none";
			load = <0x12BE0000>;
			hash@1 {
				algo = "sha1";
			};
		};
	};

	configurations {
		default = "config@imx6dl-edm1_fairy";
		/* imx6dl */
		config@imx6dl-edm1_fairy {
			description = "EDM1-FAIRY-IMX6DL";
			kernel = "kernel@1";
			ramdisk = "ramdisk@1";
			fdt = "fdt@17";
		};
		config@imx6dl-edm1-gnome {
			description = "EDM1-GNOME-IMX6DL";
			kernel = "kernel@1";
			ramdisk = "ramdisk@1";
			fdt = "fdt@18";
		};
		config@imx6dl-edm1_tc0700 {
			description = "EDM1-TC0700-IMX6DL";
			kernel = "kernel@1";
			ramdisk = "ramdisk@1";
			fdt = "fdt@19";
		};
		config@imx6dl-edm1_tc1000 {
			description = "EDM1-TC1000-IMX6DL";
			kernel = "kernel@1";
			ramdisk = "ramdisk@1";
			fdt = "fdt@20";
		};
		config@imx6dl-edm1-qca_fairy {
			description = "EDM1-QCA-FAIRY-IMX6DL";
			kernel = "kernel@1";
			ramdisk = "ramdisk@1";
			fdt = "fdt@21";
		};
		config@imx6dl-edm1-qca-gnome {
			description = "EDM1-QCA-GNOME-IMX6DL";
			kernel = "kernel@1";
			ramdisk = "ramdisk@1";
			fdt = "fdt@22";
		};
		config@imx6dl-edm1-qca_tc0700 {
			description = "EDM1-QCA-TC0700-IMX6DL";
			kernel = "kernel@1";
			ramdisk = "ramdisk@1";
			fdt = "fdt@23";
		};
		config@imx6dl-edm1-qca_tc1000 {
			description = "EDM1-QCA-TC1000-IMX6DL";
			kernel = "kernel@1";
			ramdisk = "ramdisk@1";
			fdt = "fdt@24";
		};
	};
};
```

## board/technexion/edm-cf-imx6/tnrescue-imx6q.its
```
/*
 * U-Boot uImage source file with multiple kernels, ramdisks and FDT blobs
 */

/dts-v1/;

/ {
	description = "Various kernels, ramdisks and FDT blobs";
	#address-cells = <1>;

	images {
		kernel@1 {
			description = "TechNexion IMX6/IMX7 Linux Kernel";
			data = /incbin/("./zImage");
			type = "kernel";
			arch = "arm";
			os = "linux";
			compression = "none";
			load = <0x12000000>;
			entry = <0x12000000>;
			hash@2 {
				algo = "sha1";
			};
		};

		ramdisk@1 {
			description = "TechNexion Rescue/Installer Ramdisk with Qt";
			data = /incbin/("./rootfs.cpio.xz");
			type = "ramdisk";
			arch = "arm";
			os = "linux";
			compression = "none";
			load = <0x1B100000>;
			entry = <0x1B100000>;
			hash@1 {
				algo = "sha1";
			};
		};
		/* imx6q */
		fdt@25 {
			description = "imx6q-edm1_fairy";
			data = /incbin/("./dtb/imx6q-edm1_fairy.dtb");
			type = "flat_dt";
			arch = "arm";
			compression = "none";
			load = <0x1B000000>;
			hash@1 {
				algo = "sha1";
			};
		};
		fdt@26 {
			description = "imx6q-edm1_gnome";
			data = /incbin/("./dtb/imx6q-edm1_gnome.dtb");
			type = "flat_dt";
			arch = "arm";
			compression = "none";
			load = <0x1B000000>;
			hash@1 {
				algo = "sha1";
			};
		};
		fdt@27 {
			description = "imx6q-edm1_tc0700";
			data = /incbin/("./dtb/imx6q-edm1_tc0700.dtb");
			type = "flat_dt";
			arch = "arm";
			compression = "none";
			load = <0x1B000000>;
			hash@1 {
				algo = "sha1";
			};
		};
		fdt@28 {
			description = "imx6q-edm1_tc1000";
			data = /incbin/("./dtb/imx6q-edm1_tc1000.dtb");
			type = "flat_dt";
			arch = "arm";
			compression = "none";
			load = <0x1B000000>;
			hash@1 {
				algo = "sha1";
			};
		};
		fdt@29 {
			description = "imx6q-edm1-qca_fairy";
			data = /incbin/("./dtb/imx6q-edm1-qca_fairy.dtb");
			type = "flat_dt";
			arch = "arm";
			compression = "none";
			load = <0x1B000000>;
			hash@1 {
				algo = "sha1";
			};
		};
		fdt@30 {
			description = "imx6q-edm1-qca_gnome";
			data = /incbin/("./dtb/imx6q-edm1-qca_gnome.dtb");
			type = "flat_dt";
			arch = "arm";
			compression = "none";
			load = <0x1B000000>;
			hash@1 {
				algo = "sha1";
			};
		};
		fdt@31 {
			description = "imx6q-edm1-qca_tc0700";
			data = /incbin/("./dtb/imx6q-edm1-qca_tc0700.dtb");
			type = "flat_dt";
			arch = "arm";
			compression = "none";
			load = <0x1B000000>;
			hash@1 {
				algo = "sha1";
			};
		};
		fdt@32 {
			description = "imx6q-edm1-qca_tc1000";
			data = /incbin/("./dtb/imx6q-edm1-qca_tc1000.dtb");
			type = "flat_dt";
			arch = "arm";
			compression = "none";
			load = <0x1B000000>;
			hash@1 {
				algo = "sha1";
			};
		};
	};

	configurations {
		default = "config@imx6q-edm1_fairy";
		/* imx6q */
		config@imx6q-edm1_fairy {
			description = "EDM1-FAIRY-IMX6Q";
			kernel = "kernel@1";
			ramdisk = "ramdisk@1";
			fdt = "fdt@25";
		};
		config@imx6q-edm1-gnome {
			description = "EDM1-GNOME-IMX6Q";
			kernel = "kernel@1";
			ramdisk = "ramdisk@1";
			fdt = "fdt@26";
		};
		config@imx6q-edm1_tc0700 {
			description = "EDM1-TC0700-IMX6Q";
			kernel = "kernel@1";
			ramdisk = "ramdisk@1";
			fdt = "fdt@27";
		};
		config@imx6q-edm1_tc1000 {
			description = "EDM1-TC1000-IMX6Q";
			kernel = "kernel@1";
			ramdisk = "ramdisk@1";
			fdt = "fdt@28";
		};
		config@imx6q-edm1-qca_fairy {
			description = "EDM1-QCA-FAIRY-IMX6Q";
			kernel = "kernel@1";
			ramdisk = "ramdisk@1";
			fdt = "fdt@29";
		};
		config@imx6q-edm1-qca-gnome {
			description = "EDM1-QCA-GNOME-IMX6Q";
			kernel = "kernel@1";
			ramdisk = "ramdisk@1";
			fdt = "fdt@30";
		};
		config@imx6q-edm1-qca_tc0700 {
			description = "EDM1-QCA-TC0700-IMX6Q";
			kernel = "kernel@1";
			ramdisk = "ramdisk@1";
			fdt = "fdt@31";
		};
		config@imx6q-edm1-qca_tc1000 {
			description = "EDM1-QCA-TC1000-IMX6Q";
			kernel = "kernel@1";
			ramdisk = "ramdisk@1";
			fdt = "fdt@32";
		};
	};
};
```

## board/technexion/edm-cf-imx6/tnrescue-imx6qp.its
```
/*
 * U-Boot uImage source file with multiple kernels, ramdisks and FDT blobs
 */

/dts-v1/;

/ {
	description = "Various kernels, ramdisks and FDT blobs";
	#address-cells = <1>;

	images {
		kernel@1 {
			description = "TechNexion IMX6/IMX7 Linux Kernel";
			data = /incbin/("./zImage");
			type = "kernel";
			arch = "arm";
			os = "linux";
			compression = "none";
			load = <0x12000000>;
			entry = <0x12000000>;
			hash@2 {
				algo = "sha1";
			};
		};

		ramdisk@1 {
			description = "TechNexion Rescue/Installer Ramdisk with Qt";
			data = /incbin/("./rootfs.cpio.xz");
			type = "ramdisk";
			arch = "arm";
			os = "linux";
			compression = "none";
			load = <0x1B100000>;
			entry = <0x1B100000>;
			hash@1 {
				algo = "sha1";
			};
		};
		/* imx6qp */
		fdt@33 {
			description = "imx6qp-edm1_fairy";
			data = /incbin/("./dtb/imx6qp-edm1_fairy.dtb");
			type = "flat_dt";
			arch = "arm";
			compression = "none";
			load = <0x1B000000>;
			hash@1 {
				algo = "sha1";
			};
		};
		fdt@34 {
			description = "imx6qp-edm1_gnome";
			data = /incbin/("./dtb/imx6qp-edm1_gnome.dtb");
			type = "flat_dt";
			arch = "arm";
			compression = "none";
			load = <0x1B000000>;
			hash@1 {
				algo = "sha1";
			};
		};
		fdt@35 {
			description = "imx6qp-edm1_tc0700";
			data = /incbin/("./dtb/imx6qp-edm1_tc0700.dtb");
			type = "flat_dt";
			arch = "arm";
			compression = "none";
			load = <0x1B000000>;
			hash@1 {
				algo = "sha1";
			};
		};
		fdt@36 {
			description = "imx6qp-edm1_tc1000";
			data = /incbin/("./dtb/imx6qp-edm1_tc1000.dtb");
			type = "flat_dt";
			arch = "arm";
			compression = "none";
			load = <0x1B000000>;
			hash@1 {
				algo = "sha1";
			};
		};
		fdt@37 {
			description = "imx6qp-edm1-qca_fairy";
			data = /incbin/("./dtb/imx6qp-edm1-qca_fairy.dtb");
			type = "flat_dt";
			arch = "arm";
			compression = "none";
			load = <0x1B000000>;
			hash@1 {
				algo = "sha1";
			};
		};
		fdt@38 {
			description = "imx6qp-edm1-qca_gnome";
			data = /incbin/("./dtb/imx6qp-edm1-qca_gnome.dtb");
			type = "flat_dt";
			arch = "arm";
			compression = "none";
			load = <0x1B000000>;
			hash@1 {
				algo = "sha1";
			};
		};
		fdt@39 {
			description = "imx6qp-edm1-qca_tc0700";
			data = /incbin/("./dtb/imx6qp-edm1-qca_tc0700.dtb");
			type = "flat_dt";
			arch = "arm";
			compression = "none";
			load = <0x1B000000>;
			hash@1 {
				algo = "sha1";
			};
		};
		fdt@40 {
			description = "imx6qp-edm1-qca_tc1000";
			data = /incbin/("./dtb/imx6qp-edm1-qca_tc1000.dtb");
			type = "flat_dt";
			arch = "arm";
			compression = "none";
			load = <0x1B000000>;
			hash@1 {
				algo = "sha1";
			};
		};
	};

	configurations {
		default = "config@imx6qp-edm1_fairy";
		/* imx6qp */
		config@imx6qp-edm1_fairy {
			description = "EDM1-FAIRY-IMX6QP";
			kernel = "kernel@1";
			ramdisk = "ramdisk@1";
			fdt = "fdt@33";
		};
		config@imx6qp-edm1-gnome {
			description = "EDM1-GNOME-IMX6QP";
			kernel = "kernel@1";
			ramdisk = "ramdisk@1";
			fdt = "fdt@34";
		};
		config@imx6qp-edm1_tc0700 {
			description = "EDM1-TC0700-IMX6QP";
			kernel = "kernel@1";
			ramdisk = "ramdisk@1";
			fdt = "fdt@35";
		};
		config@imx6qp-edm1_tc1000 {
			description = "EDM1-TC1000-IMX6QP";
			kernel = "kernel@1";
			ramdisk = "ramdisk@1";
			fdt = "fdt@36";
		};
		config@imx6qp-edm1-qca_fairy {
			description = "EDM1-QCA-FAIRY-IMX6QP";
			kernel = "kernel@1";
			ramdisk = "ramdisk@1";
			fdt = "fdt@37";
		};
		config@imx6qp-edm1-qca-gnome {
			description = "EDM1-QCA-GNOME-IMX6QP";
			kernel = "kernel@1";
			ramdisk = "ramdisk@1";
			fdt = "fdt@38";
		};
		config@imx6qp-edm1-qca_tc0700 {
			description = "EDM1-QCA-TC0700-IMX6QP";
			kernel = "kernel@1";
			ramdisk = "ramdisk@1";
			fdt = "fdt@39";
		};
		config@imx6qp-edm1-qca_tc1000 {
			description = "EDM1-QCA-TC1000-IMX6QP";
			kernel = "kernel@1";
			ramdisk = "ramdisk@1";
			fdt = "fdt@40";
		};
	};
};
```
