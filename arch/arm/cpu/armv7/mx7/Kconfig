## board/technexion/pico-imx6/tnrescue.its
```
/*
 * U-Boot uImage source file with multiple kernels, ramdisks and FDT blobs
 */

/dts-v1/;

/ {
	description = "Various kernels, ramdisks and FDT blobs";
	#address-cells = <1>;

	images {
		kernel@1 {
			description = "TechNexion IMX6/IMX7 Linux Kernel";
			data = /incbin/("./zImage");
			type = "kernel";
			arch = "arm";
			os = "linux";
			compression = "none";
			load = <0x12000000>;
			entry = <0x12000000>;
			hash@1 {
				algo = "sha1";
			};
		};

		ramdisk@1 {
			description = "TechNexion Rescue/Installer Ramdisk with Qt";
			data = /incbin/("./rootfs.cpio.xz");
			type = "ramdisk";
			arch = "arm";
			os = "linux";
			compression = "none";
			load = <0x18100000>;
			entry = <0x18100000>;
			hash@1 {
				algo = "sha1";
			};
		};
		/* imx6dl */
		fdt@1 {
			description = "imx6dl-pico-dwarf";
			data = /incbin/("./dtb/imx6dl-pico-dwarf.dtb");
			type = "flat_dt";
			arch = "arm";
			compression = "none";
			load = <0x18000000>;
			hash@1 {
				algo = "sha1";
			};
		};
		fdt@2 {
			description = "imx6dl-pico-hobbit";
			data = /incbin/("./dtb/imx6dl-pico-hobbit.dtb");
			type = "flat_dt";
			arch = "arm";
			compression = "none";
			load = <0x18000000>;
			hash@1 {
				algo = "sha1";
			};
		};
		fdt@3 {
			description = "imx6dl-pico-nymph";
			data = /incbin/("./dtb/imx6dl-pico-nymph.dtb");
			type = "flat_dt";
			arch = "arm";
			compression = "none";
			load = <0x18000000>;
			hash@1 {
				algo = "sha1";
			};
		};
		fdt@4 {
			description = "imx6dl-pico-pi";
			data = /incbin/("./dtb/imx6dl-pico-pi.dtb");
			type = "flat_dt";
			arch = "arm";
			compression = "none";
			load = <0x18000000>;
			hash@1 {
				algo = "sha1";
			};
		};
		fdt@5 {
			description = "imx6dl-pico-dwarf-qca";
			data = /incbin/("./dtb/imx6dl-pico-dwarf-qca.dtb");
			type = "flat_dt";
			arch = "arm";
			compression = "none";
			load = <0x18000000>;
			hash@1 {
				algo = "sha1";
			};
		};
		fdt@6 {
			description = "imx6dl-pico-hobbit-qca";
			data = /incbin/("./dtb/imx6dl-pico-hobbit-qca.dtb");
			type = "flat_dt";
			arch = "arm";
			compression = "none";
			load = <0x18000000>;
			hash@1 {
				algo = "sha1";
			};
		};
		fdt@7 {
			description = "imx6dl-pico-nymph-qca";
			data = /incbin/("./dtb/imx6dl-pico-nymph-qca.dtb");
			type = "flat_dt";
			arch = "arm";
			compression = "none";
			load = <0x18000000>;
			hash@1 {
				algo = "sha1";
			};
		};
		fdt@8 {
			description = "imx6dl-pico-pi-qca";
			data = /incbin/("./dtb/imx6dl-pico-pi-qca.dtb");
			type = "flat_dt";
			arch = "arm";
			compression = "none";
			load = <0x18000000>;
			hash@1 {
				algo = "sha1";
			};
		};
		/* imx6q */
		fdt@9 {
			description = "imx6q-pico-dwarf";
			data = /incbin/("./dtb/imx6q-pico-dwarf.dtb");
			type = "flat_dt";
			arch = "arm";
			compression = "none";
			load = <0x18000000>;
			hash@1 {
				algo = "sha1";
			};
		};
		fdt@10 {
			description = "imx6q-pico-hobbit";
			data = /incbin/("./dtb/imx6q-pico-hobbit.dtb");
			type = "flat_dt";
			arch = "arm";
			compression = "none";
			load = <0x18000000>;
			hash@1 {
				algo = "sha1";
			};
		};
		fdt@11 {
			description = "imx6q-pico-nymph";
			data = /incbin/("./dtb/imx6q-pico-nymph.dtb");
			type = "flat_dt";
			arch = "arm";
			compression = "none";
			load = <0x18000000>;
			hash@1 {
				algo = "sha1";
			};
		};
		fdt@12 {
			description = "imx6q-pico-pi";
			data = /incbin/("./dtb/imx6q-pico-pi.dtb");
			type = "flat_dt";
			arch = "arm";
			compression = "none";
			load = <0x18000000>;
			hash@1 {
				algo = "sha1";
			};
		};
		fdt@13 {
			description = "imx6q-pico-dwarf-qca";
			data = /incbin/("./dtb/imx6q-pico-dwarf-qca.dtb");
			type = "flat_dt";
			arch = "arm";
			compression = "none";
			load = <0x18000000>;
			hash@1 {
				algo = "sha1";
			};
		};
		fdt@14 {
			description = "imx6q-pico-hobbit-qca";
			data = /incbin/("./dtb/imx6q-pico-hobbit-qca.dtb");
			type = "flat_dt";
			arch = "arm";
			compression = "none";
			load = <0x18000000>;
			hash@1 {
				algo = "sha1";
			};
		};
		fdt@15 {
			description = "imx6q-pico-nymph-qca";
			data = /incbin/("./dtb/imx6q-pico-nymph-qca.dtb");
			type = "flat_dt";
			arch = "arm";
			compression = "none";
			load = <0x18000000>;
			hash@1 {
				algo = "sha1";
			};
		};
		fdt@16 {
			description = "imx6q-pico-pi-qca";
			data = /incbin/("./dtb/imx6q-pico-pi-qca.dtb");
			type = "flat_dt";
			arch = "arm";
			compression = "none";
			load = <0x18000000>;
			hash@1 {
				algo = "sha1";
			};
		};
	};

	configurations {
		/* imx6dl */
		config@imx6dl-pico-dwarf {
			description = "PICO-DWARF-IMX6DL";
			kernel = "kernel@1";
			ramdisk = "ramdisk@1";
			fdt = "fdt@1";
		};
		config@imx6dl-pico-hobbit {
			description = "PICO-HOBBIT-IMX6DL";
			kernel = "kernel@1";
			ramdisk = "ramdisk@1";
			fdt = "fdt@2";
		};
		config@imx6dl-pico-nymph {
			description = "PICO-NYMPH-IMX6DL";
			kernel = "kernel@1";
			ramdisk = "ramdisk@1";
			fdt = "fdt@3";
		};
		config@imx6dl-pico-pi {
			description = "PICO-PI-IMX6DL";
			kernel = "kernel@1";
			ramdisk = "ramdisk@1";
			fdt = "fdt@4";
		};
		config@imx6dl-pico-dwarf-qca {
			description = "PICO-DWARF-QCA-IMX6DL";
			kernel = "kernel@1";
			ramdisk = "ramdisk@1";
			fdt = "fdt@5";
		};
		config@imx6dl-pico-hobbit-qca {
			description = "PICO-HOBBIT-QCA-IMX6DL";
			kernel = "kernel@1";
			ramdisk = "ramdisk@1";
			fdt = "fdt@6";
		};
		config@imx6dl-pico-nymph-qca {
			description = "PICO-NYMPH-QCA-IMX6DL";
			kernel = "kernel@1";
			ramdisk = "ramdisk@1";
			fdt = "fdt@7";
		};
		config@imx6dl-pico-pi-qca {
			description = "PICO-PI-QCA-IMX6DL";
			kernel = "kernel@1";
			ramdisk = "ramdisk@1";
			fdt = "fdt@8";
		};
		/* imx6q */
		config@imx6q-pico-dwarf {
			description = "PICO-DWARF-IMX6Q";
			kernel = "kernel@1";
			ramdisk = "ramdisk@1";
			fdt = "fdt@9";
		};
		config@imx6q-pico-hobbit {
			description = "PICO-HOBBIT-IMX6Q";
			kernel = "kernel@1";
			ramdisk = "ramdisk@1";
			fdt = "fdt@10";
		};
		config@imx6q-pico-nymph {
			description = "PICO-NYMPH-IMX6Q";
			kernel = "kernel@1";
			ramdisk = "ramdisk@1";
			fdt = "fdt@11";
		};
		config@imx6q-pico-pi {
			description = "PICO-PI-IMX6Q";
			kernel = "kernel@1";
			ramdisk = "ramdisk@1";
			fdt = "fdt@12";
		};
		config@imx6q-pico-dwarf-qca {
			description = "PICO-DWARF-QCA-IMX6Q";
			kernel = "kernel@1";
			ramdisk = "ramdisk@1";
			fdt = "fdt@13";
		};
		config@imx6q-pico-hobbit-qca {
			description = "PICO-HOBBIT-QCA-IMX6Q";
			kernel = "kernel@1";
			ramdisk = "ramdisk@1";
			fdt = "fdt@14";
		};
		config@imx6q-pico-nymph-qca {
			description = "PICO-NYMPH-QCA-IMX6Q";
			kernel = "kernel@1";
			ramdisk = "ramdisk@1";
			fdt = "fdt@15";
		};
		config@imx6q-pico-pi-qca {
			description = "PICO-PI-QCA-IMX6Q";
			kernel = "kernel@1";
			ramdisk = "ramdisk@1";
			fdt = "fdt@16";
		};
	};
};
```

## board/technexion/pico-imx6ul/tnrescue.its
```
/*
 * U-Boot uImage source file with multiple kernels, ramdisks and FDT blobs
 */

/dts-v1/;

/ {
	description = "Various kernels, ramdisks and FDT blobs";
	#address-cells = <1>;

	images {
		kernel@1 {
			description = "TechNexion IMX6/IMX7/IMX8 Linux Kernel";
			data = /incbin/("./zImage");
			type = "kernel";
			arch = "arm";
			os = "linux";
			compression = "none";
			load = <0x80800000>;
			entry = <0x80800000>;
			hash@2 {
				algo = "md5";
			};
		};

		ramdisk@1 {
			description = "TechNexion Rescue/Installer Ramdisk with Qt";
			data = /incbin/("./rootfs.cpio.xz");
			type = "ramdisk";
			arch = "arm";
			os = "linux";
			compression = "none";
			load = <0x83800000>;
			entry = <0x83800000>;
			hash@1 {
				algo = "sha1";
			};
		};
		/* imx6ul */
		fdt@1 {
			description = "imx6ul-pico_dwarf";
			data = /incbin/("./dtb/imx6ul-pico_dwarf.dtb");
			type = "flat_dt";
			arch = "arm";
			compression = "none";
			load = <0x83000000>;
			hash@1 {
				algo = "crc32";
			};
		};
		fdt@2 {
			description = "imx6ul-pico_nymph";
			data = /incbin/("./dtb/imx6ul-pico_nymph.dtb");
			type = "flat_dt";
			arch = "arm";
			compression = "none";
			load = <0x83000000>;
			hash@1 {
				algo = "crc32";
			};
		};
		fdt@3 {
			description = "imx6ul-pico_hobbit";
			data = /incbin/("./dtb/imx6ul-pico_hobbit.dtb");
			type = "flat_dt";
			arch = "arm";
			compression = "none";
			load = <0x83000000>;
			hash@1 {
				algo = "crc32";
			};
		};
		fdt@4 {
			description = "imx6ul-pico_pi";
			data = /incbin/("./dtb/imx6ul-pico_pi.dtb");
			type = "flat_dt";
			arch = "arm";
			compression = "none";
			load = <0x83000000>;
			hash@1 {
				algo = "crc32";
			};
		};
		fdt@5 {
			description = "imx6ul-pico-qca_dwarf";
			data = /incbin/("./dtb/imx6ul-pico-qca_dwarf.dtb");
			type = "flat_dt";
			arch = "arm";
			compression = "none";
			load = <0x83000000>;
			hash@1 {
				algo = "crc32";
			};
		};
		fdt@6 {
			description = "imx6ul-pico-qca_nymph";
			data = /incbin/("./dtb/imx6ul-pico-qca_nymph.dtb");
			type = "flat_dt";
			arch = "arm";
			compression = "none";
			load = <0x83000000>;
			hash@1 {
				algo = "crc32";
			};
		};
		fdt@7 {
			description = "imx6ul-pico-qca_hobbit";
			data = /incbin/("./dtb/imx6ul-pico-qca_hobbit.dtb");
			type = "flat_dt";
			arch = "arm";
			compression = "none";
			load = <0x83000000>;
			hash@1 {
				algo = "crc32";
			};
		};
		fdt@8 {
			description = "imx6ul-pico-qca_pi";
			data = /incbin/("./dtb/imx6ul-pico-qca_pi.dtb");
			type = "flat_dt";
			arch = "arm";
			compression = "none";
			load = <0x83000000>;
			hash@1 {
				algo = "crc32";
			};
		};
		/* imx6ull */
		fdt@9 {
			description = "imx6ull-pico_dwarf";
			data = /incbin/("./dtb/imx6ull-pico_dwarf.dtb");
			type = "flat_dt";
			arch = "arm";
			compression = "none";
			load = <0x83000000>;
			hash@1 {
				algo = "crc32";
			};
		};
		fdt@10 {
			description = "imx6ull-pico_nymph";
			data = /incbin/("./dtb/imx6ull-pico_nymph.dtb");
			type = "flat_dt";
			arch = "arm";
			compression = "none";
			load = <0x83000000>;
			hash@1 {
				algo = "crc32";
			};
		};
		fdt@11 {
			description = "imx6ull-pico_hobbit";
			data = /incbin/("./dtb/imx6ull-pico_hobbit.dtb");
			type = "flat_dt";
			arch = "arm";
			compression = "none";
			load = <0x83000000>;
			hash@1 {
				algo = "crc32";
			};
		};
		fdt@12 {
			description = "imx6ull-pico_pi";
			data = /incbin/("./dtb/imx6ull-pico_pi.dtb");
			type = "flat_dt";
			arch = "arm";
			compression = "none";
			load = <0x83000000>;
			hash@1 {
				algo = "crc32";
			};
		};
		fdt@13 {
			description = "imx6ull-pico-qca_dwarf";
			data = /incbin/("./dtb/imx6ull-pico-qca_dwarf.dtb");
			type = "flat_dt";
			arch = "arm";
			compression = "none";
			load = <0x83000000>;
			hash@1 {
				algo = "crc32";
			};
		};
		fdt@14 {
			description = "imx6ull-pico-qca_nymph";
			data = /incbin/("./dtb/imx6ull-pico-qca_nymph.dtb");
			type = "flat_dt";
			arch = "arm";
			compression = "none";
			load = <0x83000000>;
			hash@1 {
				algo = "crc32";
			};
		};
		fdt@15 {
			description = "imx6ull-pico-qca_hobbit";
			data = /incbin/("./dtb/imx6ull-pico-qca_hobbit.dtb");
			type = "flat_dt";
			arch = "arm";
			compression = "none";
			load = <0x83000000>;
			hash@1 {
				algo = "crc32";
			};
		};
		fdt@16 {
			description = "imx6ull-pico-qca_pi";
			data = /incbin/("./dtb/imx6ull-pico-qca_pi.dtb");
			type = "flat_dt";
			arch = "arm";
			compression = "none";
			load = <0x83000000>;
			hash@1 {
				algo = "crc32";
			};
		};
	};

	configurations {
		default = "config@imx6ul-pico_pi";
		/* imx6ul */
		config@imx6ul-pico_dwarf {
			description = "PICO-DWARF-IMX6UL";
			kernel = "kernel@1";
			ramdisk = "ramdisk@1";
			fdt = "fdt@1";
		};
		config@imx6ul-pico_nymph {
			description = "PICO-NYMPH-IMX6UL";
			kernel = "kernel@1";
			ramdisk = "ramdisk@1";
			fdt = "fdt@2";
		};
		config@imx6ul-pico_hobbit {
			description = "PICO-HOBBIT-IMX6UL";
			kernel = "kernel@1";
			ramdisk = "ramdisk@1";
			fdt = "fdt@3";
		};
		config@imx6ul-pico_pi {
			description = "PICO-PI-IMX6UL";
			kernel = "kernel@1";
			ramdisk = "ramdisk@1";
			fdt = "fdt@4";
		};
		config@imx6ul-pico_dwarf {
			description = "PICO-DWARF-IMX6UL";
			kernel = "kernel@1";
			ramdisk = "ramdisk@1";
			fdt = "fdt@5";
		};
		config@imx6ul-pico_nymph {
			description = "PICO-NYMPH-IMX6UL";
			kernel = "kernel@1";
			ramdisk = "ramdisk@1";
			fdt = "fdt@6";
		};
		config@imx6ul-pico_hobbit {
			description = "PICO-HOBBIT-IMX6UL";
			kernel = "kernel@1";
			ramdisk = "ramdisk@1";
			fdt = "fdt@7";
		};
		config@imx6ul-pico_pi {
			description = "PICO-PI-IMX6UL";
			kernel = "kernel@1";
			ramdisk = "ramdisk@1";
			fdt = "fdt@8";
		};
		/* imx6ull */
		config@imx6ull-pico_dwarf {
			description = "PICO-DWARF-IMX6ULL";
			kernel = "kernel@1";
			ramdisk = "ramdisk@1";
			fdt = "fdt@9";
		};
		config@imx6ull-pico_nymph {
			description = "PICO-NYMPH-IMX6ULL";
			kernel = "kernel@1";
			ramdisk = "ramdisk@1";
			fdt = "fdt@10";
		};
		config@imx6ull-pico_hobbit {
			description = "PICO-HOBBIT-IMX6ULL";
			kernel = "kernel@1";
			ramdisk = "ramdisk@1";
			fdt = "fdt@11";
		};
		config@imx6ull-pico_pi {
			description = "PICO-PI-IMX6ULL";
			kernel = "kernel@1";
			ramdisk = "ramdisk@1";
			fdt = "fdt@12";
		};
		config@imx6ull-pico-qca_dwarf {
			description = "PICO-DWARF-QCA-IMX6ULL";
			kernel = "kernel@1";
			ramdisk = "ramdisk@1";
			fdt = "fdt@13";
		};
		config@imx6ull-pico-qca_nymph {
			description = "PICO-NYMPH-QCA-IMX6ULL";
			kernel = "kernel@1";
			ramdisk = "ramdisk@1";
			fdt = "fdt@14";
		};
		config@imx6ull-pico-qca_hobbit {
			description = "PICO-HOBBIT-QCA-IMX6ULL";
			kernel = "kernel@1";
			ramdisk = "ramdisk@1";
			fdt = "fdt@15";
		};
		config@imx6ull-pico-qca_pi {
			description = "PICO-PI-QCA-IMX6ULL";
			kernel = "kernel@1";
			ramdisk = "ramdisk@1";
			fdt = "fdt@16";
		};
	};
};
```
