## board/technexion/edm-cf-imx6/tnrescue.its
```
/*
 * U-Boot uImage source file with multiple kernels, ramdisks and FDT blobs
 */

/dts-v1/;

/ {
	description = "Various kernels, ramdisks and FDT blobs";
	#address-cells = <1>;

	images {
		kernel@1 {
			description = "TechNexion IMX6/IMX7 Linux Kernel";
			data = /incbin/("./zImage");
			type = "kernel";
			arch = "arm";
			os = "linux";
			compression = "none";
			load = <0x12000000>;
			entry = <0x12000000>;
			hash@2 {
				algo = "sha1";
			};
		};

		ramdisk@1 {
			description = "TechNexion Rescue/Installer Ramdisk with Qt";
			data = /incbin/("./rootfs.cpio.xz");
			type = "ramdisk";
			arch = "arm";
			os = "linux";
			compression = "none";
			load = <0x1B100000>;
			entry = <0x1B100000>;
			hash@1 {
				algo = "sha1";
			};
		};
		/* imx6dl */
		fdt@17 {
			description = "imx6dl-edm1_fairy";
			data = /incbin/("./dtb/imx6dl-edm1_fairy.dtb");
			type = "flat_dt";
			arch = "arm";
			compression = "none";
			load = <0x1B000000>;
			hash@1 {
				algo = "sha1";
			};
		};
		fdt@18 {
			description = "imx6dl-edm1_gnome";
			data = /incbin/("./dtb/imx6dl-edm1_gnome.dtb");
			type = "flat_dt";
			arch = "arm";
			compression = "none";
			load = <0x1B000000>;
			hash@1 {
				algo = "sha1";
			};
		};
		fdt@19 {
			description = "imx6dl-edm1_tc0700";
			data = /incbin/("./dtb/imx6dl-edm1_tc0700.dtb");
			type = "flat_dt";
			arch = "arm";
			compression = "none";
			load = <0x1B000000>;
			hash@1 {
				algo = "sha1";
			};
		};
		fdt@20 {
			description = "imx6dl-edm1_tc1000";
			data = /incbin/("./dtb/imx6dl-edm1_tc1000.dtb");
			type = "flat_dt";
			arch = "arm";
			compression = "none";
			load = <0x1B000000>;
			hash@1 {
				algo = "sha1";
			};
		};
		/* imx6q */
		fdt@25 {
			description = "imx6q-edm1_fairy";
			data = /incbin/("./dtb/imx6q-edm1_fairy.dtb");
			type = "flat_dt";
			arch = "arm";
			compression = "none";
			load = <0x1B000000>;
			hash@1 {
				algo = "sha1";
			};
		};
		fdt@26 {
			description = "imx6q-edm1_gnome";
			data = /incbin/("./dtb/imx6q-edm1_gnome.dtb");
			type = "flat_dt";
			arch = "arm";
			compression = "none";
			load = <0x1B000000>;
			hash@1 {
				algo = "sha1";
			};
		};
		fdt@27 {
			description = "imx6q-edm1_tc0700";
			data = /incbin/("./dtb/imx6q-edm1_tc0700.dtb");
			type = "flat_dt";
			arch = "arm";
			compression = "none";
			load = <0x1B000000>;
			hash@1 {
				algo = "sha1";
			};
		};
		fdt@28 {
			description = "imx6q-edm1_tc1000";
			data = /incbin/("./dtb/imx6q-edm1_tc1000.dtb");
			type = "flat_dt";
			arch = "arm";
			compression = "none";
			load = <0x1B000000>;
			hash@1 {
				algo = "sha1";
			};
		};
		/* imx6qp */
		fdt@33 {
			description = "imx6qp-edm1_fairy";
			data = /incbin/("./dtb/imx6qp-edm1_fairy.dtb");
			type = "flat_dt";
			arch = "arm";
			compression = "none";
			load = <0x1B000000>;
			hash@1 {
				algo = "sha1";
			};
		};
	};

	configurations {
		default = "config@imx6dl-edm1_fairy";
		/* imx6dl */
		config@imx6dl-edm1_fairy {
			description = "EDM1-FAIRY-IMX6DL";
			kernel = "kernel@1";
			ramdisk = "ramdisk@1";
			fdt = "fdt@17";
		};
		config@imx6dl-edm1-gnome {
			description = "EDM1-GNOME-IMX6DL";
			kernel = "kernel@1";
			ramdisk = "ramdisk@1";
			fdt = "fdt@18";
		};
		config@imx6dl-edm1_tc0700 {
			description = "EDM1-TC0700-IMX6DL";
			kernel = "kernel@1";
			ramdisk = "ramdisk@1";
			fdt = "fdt@19";
		};
		config@imx6dl-edm1_tc1000 {
			description = "EDM1-TC1000-IMX6DL";
			kernel = "kernel@1";
			ramdisk = "ramdisk@1";
			fdt = "fdt@20";
		};
		/* imx6q */
		config@imx6q-edm1_fairy {
			description = "EDM1-FAIRY-IMX6Q";
			kernel = "kernel@1";
			ramdisk = "ramdisk@1";
			fdt = "fdt@25";
		};
		config@imx6q-edm1-gnome {
			description = "EDM1-GNOME-IMX6Q";
			kernel = "kernel@1";
			ramdisk = "ramdisk@1";
			fdt = "fdt@26";
		};
		config@imx6q-edm1_tc0700 {
			description = "EDM1-TC0700-IMX6Q";
			kernel = "kernel@1";
			ramdisk = "ramdisk@1";
			fdt = "fdt@27";
		};
		config@imx6q-edm1_tc1000 {
			description = "EDM1-TC1000-IMX6Q";
			kernel = "kernel@1";
			ramdisk = "ramdisk@1";
			fdt = "fdt@28";
		};
		/* imx6qp */
		config@imx6qp-edm1_fairy {
			description = "EDM1-FAIRY-IMX6QP";
			kernel = "kernel@1";
			ramdisk = "ramdisk@1";
			fdt = "fdt@33";
		};
	};
};
```

## board/technexion/edm1-imx6ul-nand/Kconfig
```kconfig
if TARGET_EDM1_IMX6UL_NAND

config SYS_BOARD
	default "edm1-imx6ul-nand"

config SYS_VENDOR
	default "technexion"

config SYS_SOC
	default "mx6"

config SYS_CONFIG_NAME
	default "edm1-imx6ul-nand"

endif
```

## board/technexion/edm1-imx7d/Kconfig
```kconfig
if TARGET_EDM1_IMX7D

config SYS_BOARD
	default "edm1-imx7d"

config SYS_VENDOR
	default "technexion"

config SYS_SOC
	default "mx7"

config SYS_CONFIG_NAME
	default "edm1-imx7d"

endif
```

## board/technexion/edm1-imx7d/tnrescue.its
```
/*
 * U-Boot uImage source file with multiple kernels, ramdisks and FDT blobs
 */

/dts-v1/;

/ {
	description = "Various kernels, ramdisks and FDT blobs";
	#address-cells = <1>;

	images {
		kernel@1 {
			description = "TechNexion IMX6/IMX7 Linux Kernel";
			data = /incbin/("./zImage");
			type = "kernel";
			arch = "arm";
			os = "linux";
			compression = "none";
			load = <0x80800000>;
			entry = <0x80800000>;
			hash@1 {
				algo = "md5";
			};
			hash@2 {
				algo = "sha1";
			};
		};
		ramdisk@1 {
			description = "TechNexion Installer Ramdisk with Qt";
			data = /incbin/("./rootfs.cpio.xz");
			type = "ramdisk";
			arch = "arm";
			os = "linux";
			compression = "none";
			load = <0x83800000>;
			entry = <0x83800000>;
			hash@1 {
				algo = "sha1";
			};
		};
		fdt@11 {
			description = "imx7d-edm1-qca_gnome";
			data = /incbin/("./dtb/imx7d-edm1-qca_gnome.dtb");
			type = "flat_dt";
			arch = "arm";
			compression = "none";
			load = <0x83000000>;
			hash@1 {
				algo = "sha1";
			};
		};
		fdt@12 {
			description = "imx7d-edm1-qca_gnome-m4";
			data = /incbin/("./dtb/imx7d-edm1-qca_gnome-m4.dtb");
			type = "flat_dt";
			arch = "arm";
			compression = "none";
			load = <0x83000000>;
			hash@1 {
				algo = "sha1";
			};
		};
	};

	configurations {
		default = "config@imx7d-edm1-qca_gnome";
		config@imx7d-edm1-qca_gnome {
			description = "EDM1-QCA-GNOME-IMX7D";
			kernel = "kernel@1";
			ramdisk = "ramdisk@1";
			fdt = "fdt@11";
		};
		config@imx7d-edm1-qca_gnome-m4 {
			description = "EDM1-QCA-GNOME-IMX7D-M4";
			kernel = "kernel@1";
			ramdisk = "ramdisk@1";
			fdt = "fdt@12";
		};
	};
};
```

## board/technexion/pico-8m/Kconfig
```kconfig
if TARGET_PICO_8M

config SYS_BOARD
	default "pico-8m"

config SYS_VENDOR
	default "technexion"

config SYS_CONFIG_NAME
	default "pico-8m"

endif
```

## board/technexion/pico-imx6/tnrescue-imx6dl.its
```
/*
 * U-Boot uImage source file with multiple kernels, ramdisks and FDT blobs
 */

/dts-v1/;

/ {
	description = "Various kernels, ramdisks and FDT blobs";
	#address-cells = <1>;

	images {
		kernel@1 {
			description = "TechNexion IMX6/IMX7 Linux Kernel";
			data = /incbin/("./zImage");
			type = "kernel";
			arch = "arm";
			os = "linux";
			compression = "none";
			load = <0x12000000>;
			entry = <0x12000000>;
			hash@2 {
				algo = "sha1";
			};
		};

		ramdisk@1 {
			description = "TechNexion Rescue/Installer Ramdisk with Qt";
			data = /incbin/("./rootfs.cpio.xz");
			type = "ramdisk";
			arch = "arm";
			os = "linux";
			compression = "none";
			load = <0x12C00000>;
			entry = <0x1B000000>;
			hash@1 {
				algo = "sha1";
			};
		};
		/* imx6dl */
		fdt@1 {
			description = "imx6dl-pico_dwarf";
			data = /incbin/("./dtb/imx6dl-pico_dwarf.dtb");
			type = "flat_dt";
			arch = "arm";
			compression = "none";
			load = <0x12BE0000>;
			hash@1 {
				algo = "sha1";
			};
		};
		fdt@2 {
			description = "imx6dl-pico_hobbit";
			data = /incbin/("./dtb/imx6dl-pico_hobbit.dtb");
			type = "flat_dt";
			arch = "arm";
			compression = "none";
			load = <0x12BE0000>;
			hash@1 {
				algo = "sha1";
			};
		};
		fdt@3 {
			description = "imx6dl-pico_nymph";
			data = /incbin/("./dtb/imx6dl-pico_nymph.dtb");
			type = "flat_dt";
			arch = "arm";
			compression = "none";
			load = <0x12BE0000>;
			hash@1 {
				algo = "sha1";
			};
		};
		fdt@4 {
			description = "imx6dl-pico_pi";
			data = /incbin/("./dtb/imx6dl-pico_pi.dtb");
			type = "flat_dt";
			arch = "arm";
			compression = "none";
			load = <0x12BE0000>;
			hash@1 {
				algo = "sha1";
			};
		};
		fdt@5 {
			description = "imx6dl-pico-qca_dwarf";
			data = /incbin/("./dtb/imx6dl-pico-qca_dwarf.dtb");
			type = "flat_dt";
			arch = "arm";
			compression = "none";
			load = <0x12BE0000>;
			hash@1 {
				algo = "sha1";
			};
		};
		fdt@6 {
			description = "imx6dl-pico-qca_hobbit";
			data = /incbin/("./dtb/imx6dl-pico-qca_hobbit.dtb");
			type = "flat_dt";
			arch = "arm";
			compression = "none";
			load = <0x12BE0000>;
			hash@1 {
				algo = "sha1";
			};
		};
		fdt@7 {
			description = "imx6dl-pico-qca_nymph";
			data = /incbin/("./dtb/imx6dl-pico-qca_nymph.dtb");
			type = "flat_dt";
			arch = "arm";
			compression = "none";
			load = <0x12BE0000>;
			hash@1 {
				algo = "sha1";
			};
		};
		fdt@8 {
			description = "imx6dl-pico-qca_pi";
			data = /incbin/("./dtb/imx6dl-pico-qca_pi.dtb");
			type = "flat_dt";
			arch = "arm";
			compression = "none";
			load = <0x12BE0000>;
			hash@1 {
				algo = "sha1";
			};
		};
	};

	configurations {
		default = "config@imx6dl-pico_dwarf";
		/* imx6dl */
		config@imx6dl-pico_dwarf {
			description = "PICO-DWARF-IMX6DL";
			kernel = "kernel@1";
			ramdisk = "ramdisk@1";
			fdt = "fdt@1";
		};
		config@imx6dl-pico_hobbit {
			description = "PICO-HOBBIT-IMX6DL";
			kernel = "kernel@1";
			ramdisk = "ramdisk@1";
			fdt = "fdt@2";
		};
		config@imx6dl-pico_nymph {
			description = "PICO-NYMPH-IMX6DL";
			kernel = "kernel@1";
			ramdisk = "ramdisk@1";
			fdt = "fdt@3";
		};
		config@imx6dl-pico_pi {
			description = "PICO-PI-IMX6DL";
			kernel = "kernel@1";
			ramdisk = "ramdisk@1";
			fdt = "fdt@4";
		};
		config@imx6dl-pico-qca_dwarf {
			description = "PICO-QCA-DWARF-IMX6DL";
			kernel = "kernel@1";
			ramdisk = "ramdisk@1";
			fdt = "fdt@5";
		};
		config@imx6dl-pico-qca_hobbit {
			description = "PICO-QCA-HOBBIT-IMX6DL";
			kernel = "kernel@1";
			ramdisk = "ramdisk@1";
			fdt = "fdt@6";
		};
		config@imx6dl-pico-qca_nymph {
			description = "PICO-QCA-NYMPH-IMX6DL";
			kernel = "kernel@1";
			ramdisk = "ramdisk@1";
			fdt = "fdt@7";
		};
		config@imx6dl-pico-qca_pi {
			description = "PICO-QCA-PI-IMX6DL";
			kernel = "kernel@1";
			ramdisk = "ramdisk@1";
			fdt = "fdt@8";
		};
	};
};
```

## board/technexion/pico-imx6/tnrescue-imx6q.its
```
/*
 * U-Boot uImage source file with multiple kernels, ramdisks and FDT blobs
 */

/dts-v1/;

/ {
	description = "Various kernels, ramdisks and FDT blobs";
	#address-cells = <1>;

	images {
		kernel@1 {
			description = "TechNexion IMX6/IMX7 Linux Kernel";
			data = /incbin/("./zImage");
			type = "kernel";
			arch = "arm";
			os = "linux";
			compression = "none";
			load = <0x12000000>;
			entry = <0x12000000>;
			hash@2 {
				algo = "sha1";
			};
		};

		ramdisk@1 {
			description = "TechNexion Rescue/Installer Ramdisk with Qt";
			data = /incbin/("./rootfs.cpio.xz");
			type = "ramdisk";
			arch = "arm";
			os = "linux";
			compression = "none";
			load = <0x12C00000>;
			entry = <0x1B000000>;
			hash@1 {
				algo = "sha1";
			};
		};
		/* imx6q */
		fdt@9 {
			description = "imx6q-pico_dwarf";
			data = /incbin/("./dtb/imx6q-pico_dwarf.dtb");
			type = "flat_dt";
			arch = "arm";
			compression = "none";
			load = <0x12BE0000>;
			hash@1 {
				algo = "sha1";
			};
		};
		fdt@10 {
			description = "imx6q-pico_hobbit";
			data = /incbin/("./dtb/imx6q-pico_hobbit.dtb");
			type = "flat_dt";
			arch = "arm";
			compression = "none";
			load = <0x12BE0000>;
			hash@1 {
				algo = "sha1";
			};
		};
		fdt@11 {
			description = "imx6q-pico_nymph";
			data = /incbin/("./dtb/imx6q-pico_nymph.dtb");
			type = "flat_dt";
			arch = "arm";
			compression = "none";
			load = <0x12BE0000>;
			hash@1 {
				algo = "sha1";
			};
		};
		fdt@12 {
			description = "imx6q-pico_pi";
			data = /incbin/("./dtb/imx6q-pico_pi.dtb");
			type = "flat_dt";
			arch = "arm";
			compression = "none";
			load = <0x12BE0000>;
			hash@1 {
				algo = "sha1";
			};
		};
		fdt@13 {
			description = "imx6q-pico-qca_dwarf";
			data = /incbin/("./dtb/imx6q-pico-qca_dwarf.dtb");
			type = "flat_dt";
			arch = "arm";
			compression = "none";
			load = <0x12BE0000>;
			hash@1 {
				algo = "sha1";
			};
		};
		fdt@14 {
			description = "imx6q-pico-qca_hobbit";
			data = /incbin/("./dtb/imx6q-pico-qca_hobbit.dtb");
			type = "flat_dt";
			arch = "arm";
			compression = "none";
			load = <0x12BE0000>;
			hash@1 {
				algo = "sha1";
			};
		};
		fdt@15 {
			description = "imx6q-pico_nymph";
			data = /incbin/("./dtb/imx6q-pico-qca_nymph.dtb");
			type = "flat_dt";
			arch = "arm";
			compression = "none";
			load = <0x12BE0000>;
			hash@1 {
				algo = "sha1";
			};
		};
		fdt@16 {
			description = "imx6q-pico-qca_pi";
			data = /incbin/("./dtb/imx6q-pico-qca_pi.dtb");
			type = "flat_dt";
			arch = "arm";
			compression = "none";
			load = <0x12BE0000>;
			hash@1 {
				algo = "sha1";
			};
		};
	};

	configurations {
		default = "config@imx6q-pico_dwarf";
		/* imx6q */
		config@imx6q-pico_dwarf {
			description = "PICO-DWARF-IMX6Q";
			kernel = "kernel@1";
			ramdisk = "ramdisk@1";
			fdt = "fdt@9";
		};
		config@imx6q-pico_hobbit {
			description = "PICO-HOBBIT-IMX6Q";
			kernel = "kernel@1";
			ramdisk = "ramdisk@1";
			fdt = "fdt@10";
		};
		config@imx6q-pico_nymph {
			description = "PICO-NYMPH-IMX6Q";
			kernel = "kernel@1";
			ramdisk = "ramdisk@1";
			fdt = "fdt@11";
		};
		config@imx6q-pico_pi {
			description = "PICO-PI-IMX6Q";
			kernel = "kernel@1";
			ramdisk = "ramdisk@1";
			fdt = "fdt@12";
		};
		config@imx6q-pico-qca_dwarf {
			description = "PICO-QCA-DWARF-IMX6Q";
			kernel = "kernel@1";
			ramdisk = "ramdisk@1";
			fdt = "fdt@13";
		};
		config@imx6q-pico-qca_hobbit {
			description = "PICO-QCA-HOBBIT-IMX6Q";
			kernel = "kernel@1";
			ramdisk = "ramdisk@1";
			fdt = "fdt@14";
		};
		config@imx6q-pico-qca_nymph {
			description = "PICO-QCA-NYMPH-IMX6Q";
			kernel = "kernel@1";
			ramdisk = "ramdisk@1";
			fdt = "fdt@15";
		};
		config@imx6q-pico-qca_pi {
			description = "PICO-QCA-PI-IMX6Q";
			kernel = "kernel@1";
			ramdisk = "ramdisk@1";
			fdt = "fdt@16";
		};
	};
};
```
