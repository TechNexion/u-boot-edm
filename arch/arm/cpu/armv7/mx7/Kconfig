## board/technexion/pico-imx8mm/tnrescue.its
```
/*
 * U-Boot uImage source file with multiple kernels, ramdisks and FDT blobs
 */

/dts-v1/;

/ {
	description = "Various kernels, ramdisks and FDT blobs";
	#address-cells = <1>;

	images {
		kernel@1 {
			description = "Technexion IMX8mm Linux Kernel";
			data = /incbin/("./Image");
			type = "kernel";
			arch = "arm64";
			os = "linux";
			compression = "none";
			load = <0x40480000>;
			entry = <0x40480000>;
			hash@1 {
				algo = "sha1";
			};
		};

		ramdisk@1 {
			description = "Technexion Installer Ramdisk with Qt";
			data = /incbin/("./rootfs.cpio.xz");
			type = "ramdisk";
			arch = "arm64";
			os = "linux";
			compression = "none";
			load = <0x43800000>;
			entry = <0x43800000>;
			hash@1 {
				algo = "sha1";
			};
		};

		fdt@1 {
			description = "Pico imx8mm flat device tree blob for no display";
			data = /incbin/("./dtb/imx8mm-pico-pi.dtb");
			type = "flat_dt";
			arch = "arm64";
			compression = "none";
			load = <0x43000000>;
			hash@1 {
				algo = "sha1";
			};
		};

		fdt@2 {
			description = "Pico imx8mm flat device tree blob for MIPI 5 inch panel";
			data = /incbin/("./dtb/imx8mm-pico-pi-ili9881c.dtb");
			type = "flat_dt";
			arch = "arm64";
			compression = "none";
			load = <0x43000000>;
			hash@1 {
				algo = "sha1";
			};
		};

		fdt@3 {
			description = "Pico imx8mm flat device tree blob for MIPI 8 inch panel";
			data = /incbin/("./dtb/imx8mm-pico-pi-g080uan01.dtb");
			type = "flat_dt";
			arch = "arm64";
			compression = "none";
			load = <0x43000000>;
			hash@1 {
				algo = "sha1";
			};
		};

		fdt@4 {
			description = "Pico imx8mm flat device tree blob for MIPI 10 inch panel";
			data = /incbin/("./dtb/imx8mm-pico-pi-g101uan02.dtb");
			type = "flat_dt";
			arch = "arm64";
			compression = "none";
			load = <0x43000000>;
			hash@1 {
				algo = "sha1";
			};
		};

		fdt@5 {
			description = "Pico imx8mm flat device tree blob for MIPI-LVDS bridge to 7 inch panel";
			data = /incbin/("./dtb/imx8mm-pico-pi-sn65dsi84-hj070na.dtb");
			type = "flat_dt";
			arch = "arm64";
			compression = "none";
			load = <0x43000000>;
			hash@1 {
				algo = "sha1";
			};
		};

		fdt@6 {
			description = "Pico imx8mm flat device tree blob for MIPI-LVDS bridge to 10 inch panel";
			data = /incbin/("./dtb/imx8mm-pico-pi-sn65dsi84-m101nwwb.dtb");
			type = "flat_dt";
			arch = "arm64";
			compression = "none";
			load = <0x43000000>;
			hash@1 {
				algo = "sha1";
			};
		};

		fdt@7 {
			description = "Pico imx8mm flat device tree blob with m4 MCU";
			data = /incbin/("./dtb/imx8mm-pico-pi-m4.dtb");
			type = "flat_dt";
			arch = "arm64";
			compression = "none";
			load = <0x43000000>;
			hash@1 {
				algo = "sha1";
			};
		};

		fdt@8 {
			description = "Pico imx8mm flat device tree blob for VoiceHat";
			data = /incbin/("./dtb/imx8mm-pico-pi-voicehat.dtb");
			type = "flat_dt";
			arch = "arm64";
			compression = "none";
			load = <0x43000000>;
			hash@1 {
				algo = "sha1";
			};
		};

	};

	configurations {
		config@imx8mm-pico-pi {
			description = "Boot IMX8mm with MIPI";
			kernel = "kernel@1";
			ramdisk = "ramdisk@1";
			fdt = "fdt@1";
		};
		config@imx8mm-pico-pi-ili9881c {
			description = "Boot IMX8mm with 5' mipi";
			kernel = "kernel@1";
			ramdisk = "ramdisk@1";
			fdt = "fdt@2";
		};
		config@imx8mm-pico-pi-g080uan01 {
			description = "Boot IMX8mm with 8' mipi";
			kernel = "kernel@1";
			ramdisk = "ramdisk@1";
			fdt = "fdt@3";
		};
		config@imx8mm-pico-pi-g101uan02 {
			description = "Boot IMX8mm with 10' mipi";
			kernel = "kernel@1";
			ramdisk = "ramdisk@1";
			fdt = "fdt@4";
		};
		config@imx8mm-pico-pi-sn65dsi84-hj070na {
			description = "Boot IMX8mm with bridged lvds 7' panel";
			kernel = "kernel@1";
			ramdisk = "ramdisk@1";
			fdt = "fdt@5";
		};
		config@imx8mm-pico-pi-sn65dsi84-m101nwwb {
			description = "Boot IMX8mm with bridged lvds 10' panel";
			kernel = "kernel@1";
			ramdisk = "ramdisk@1";
			fdt = "fdt@6";
		};
		config@imx8mm-pico-pi-m4 {
			description = "Boot IMX8mm with m4 MCU";
			kernel = "kernel@1";
			ramdisk = "ramdisk@1";
			fdt = "fdt@7";
		};
		config@imx8mm-pico-pi-voicehat {
			description = "Boot IMX8mm with voicehat";
			kernel = "kernel@1";
			ramdisk = "ramdisk@1";
			fdt = "fdt@8";
		};
	};
};
```

## board/technexion/pico-imx8mq/tnrescue.its
```
/*
 * U-Boot uImage source file with multiple kernels, ramdisks and FDT blobs
 */

/dts-v1/;

/ {
	description = "Various kernels, ramdisks and FDT blobs";
	#address-cells = <1>;

	images {
		kernel@1 {
			description = "Technexion IMX8mq Linux Kernel";
			data = /incbin/("./Image");
			type = "kernel";
			arch = "arm64";
			os = "linux";
			compression = "none";
			load = <0x40480000>;
			entry = <0x40480000>;
			hash@1 {
				algo = "sha1";
			};
		};

		ramdisk@1 {
			description = "Technexion Installer Ramdisk with Qt";
			data = /incbin/("./rootfs.cpio.xz");
			type = "ramdisk";
			arch = "arm64";
			os = "linux";
			compression = "none";
			load = <0x43800000>;
			entry = <0x43800000>;
			hash@1 {
				algo = "sha1";
			};
		};

		fdt@1 {
			description = "pico imx8mq for HDMI";
			data = /incbin/("./dtb/imx8mq-pico-pi.dtb");
			type = "flat_dt";
			arch = "arm64";
			compression = "none";
			load = <0x43000000>;
			hash@1 {
				algo = "sha1";
			};
		};

		fdt@2 {
			description = "pico imx8mq for 5' MIPI";
			data = /incbin/("./dtb/imx8mq-pico-pi-dcss-ili9881c.dtb");
			type = "flat_dt";
			arch = "arm64";
			compression = "none";
			load = <0x43000000>;
			hash@1 {
				algo = "sha1";
			};
		};

		fdt@3 {
			description = "pico imx8mq for DUAL display";
			data = /incbin/("./dtb/imx8mq-pico-pi-dual.dtb");
			type = "flat_dt";
			arch = "arm64";
			compression = "none";
			load = <0x43000000>;
			hash@1 {
				algo = "sha1";
			};
		};

		fdt@4 {
			description = "pico imx8mq for m4 MCU";
			data = /incbin/("./dtb/imx8mq-pico-pi-m4.dtb");
			type = "flat_dt";
			arch = "arm64";
			compression = "none";
			load = <0x43000000>;
			hash@1 {
				algo = "sha1";
			};
		};

		fdt@5 {
			description = "pico imx8mq for voicehat";
			data = /incbin/("./dtb/imx8mq-pico-pi-voicehat.dtb");
			type = "flat_dt";
			arch = "arm64";
			compression = "none";
			load = <0x43000000>;
			hash@1 {
				algo = "sha1";
			};
		};

		fdt@6 {
			description = "pico imx8mq for lcdif to mipi-lvds bridge 7' panel";
			data = /incbin/("./dtb/imx8mq-pico-pi-lcdif-sn65dsi84-hj070na.dtb");
			type = "flat_dt";
			arch = "arm64";
			compression = "none";
			load = <0x43000000>;
			hash@1 {
				algo = "sha1";
			};
		};
	};

	configurations {
		config@imx8mq-pico-pi {
			description = "Boot IMX8mq with HDMI";
			kernel = "kernel@1";
			ramdisk = "ramdisk@1";
			fdt = "fdt@1";
		};
		config@imx8mq-pico-pi-dcss-ili9881c {
			description = "Boot IMX8mq with 5' MIPI";
			kernel = "kernel@1";
			ramdisk = "ramdisk@1";
			fdt = "fdt@2";
		};
		config@imx8mq-pico-pi-dual {
			description = "Boot IMX8mq with DUAL Display";
			kernel = "kernel@1";
			ramdisk = "ramdisk@1";
			fdt = "fdt@3";
		};
		config@imx8mq-pico-pi-m4 {
			description = "Boot IMX8mq with m4 MCU";
			kernel = "kernel@1";
			ramdisk = "ramdisk@1";
			fdt = "fdt@4";
		};
		config@imx8mq-pico-pi-voicehat {
			description = "Boot IMX8mq with voicehat";
			kernel = "kernel@1";
			ramdisk = "ramdisk@1";
			fdt = "fdt@5";
		};
		config@imx8mq-pico-pi-lcdif-sn65dsi84-hj070na {
			description = "Boot IMX8mq with lcdif to mipi-lvds bridge 7' panel";
			kernel = "kernel@1";
			ramdisk = "ramdisk@1";
			fdt = "fdt@6";
		};
	};
};
```

## board/technexion/tep1-imx6ul/Kconfig
```kconfig
if TARGET_TEP1_IMX6UL

config SYS_BOARD
	default "tep1-imx6ul"

config SYS_VENDOR
	default "technexion"

config SYS_SOC
	default "mx6"

config SYS_CONFIG_NAME
	default "tep1-imx6ul"

endif
```

## board/technexion/tep1-imx7d/tnrescue.its
```
/*
 * U-Boot uImage source file with multiple kernels, ramdisks and FDT blobs
 */

/dts-v1/;

/ {
	description = "Various kernels, ramdisks and FDT blobs";
	#address-cells = <1>;

	images {
		kernel@1 {
			description = "TechNexion IMX6/IMX7/IMX8 Linux Kernel";
			data = /incbin/("./zImage");
			type = "kernel";
			arch = "arm";
			os = "linux";
			compression = "none";
			load = <0x19F00000>;
			entry = <0x19F00000>;
			hash@2 {
				algo = "md5";
			};
		};

		ramdisk@1 {
			description = "TechNexion Rescue/Installer Ramdisk with Qt";
			data = /incbin/("./rootfs.cpio.xz");
			type = "ramdisk";
			arch = "arm";
			os = "linux";
			compression = "none";
			load = <0x1B000000>;
			entry = <0x1B000000>;
			hash@1 {
				algo = "sha1";
			};
		};
		/* imx6dl */
		fdt@1 {
			description = "imx6dl-edm_fairy";
			data = /incbin/("./dtb/imx6dl-edm1-cf-pmic_fairy.dtb");
			type = "flat_dt";
			arch = "arm";
			compression = "none";
			load = <0x19E00000>;
			hash@1 {
				algo = "crc32";
			};
		};
		fdt@2 {
			description = "imx6dl-edm_tc1000";
			data = /incbin/("./dtb/imx6dl-edm1-cf-pmic_tc1000.dtb");
			type = "flat_dt";
			arch = "arm";
			compression = "none";
			load = <0x19E00000>;
			hash@1 {
				algo = "crc32";
			};
		};
		fdt@3 {
			description = "imx6dl-edm_tc1000_new-panel";
			data = /incbin/("./dtb/imx6dl-edm1-cf-pmic_tc1000_vxt101.dtb");
			type = "flat_dt";
			arch = "arm";
			compression = "none";
			load = <0x19E00000>;
			hash@1 {
				algo = "crc32";
			};
		};
		fdt@4 {
			description = "imx6dl-edm_tc0700";
			data = /incbin/("./dtb/imx6dl-edm1-cf-pmic_tc0700.dtb");
			type = "flat_dt";
			arch = "arm";
			compression = "none";
			load = <0x19E00000>;
			hash@1 {
				algo = "crc32";
			};
		};
		/* imx6q */
		fdt@5 {
			description = "imx6q-edm_fairy";
			data = /incbin/("./dtb/imx6q-edm1-cf-pmic_fairy.dtb");
			type = "flat_dt";
			arch = "arm";
			compression = "none";
			load = <0x19E00000>;
			hash@1 {
				algo = "crc32";
			};
		};
		fdt@6 {
			description = "imx6q-edm_tc1000";
			data = /incbin/("./dtb/imx6q-edm1-cf-pmic_tc1000.dtb");
			type = "flat_dt";
			arch = "arm";
			compression = "none";
			load = <0x19E00000>;
			hash@1 {
				algo = "crc32";
			};
		};
		fdt@7 {
			description = "imx6q-edm_tc1000_new-panel";
			data = /incbin/("./dtb/imx6q-edm1-cf-pmic_tc1000_vxt101.dtb");
			type = "flat_dt";
			arch = "arm";
			compression = "none";
			load = <0x19E00000>;
			hash@1 {
				algo = "crc32";
			};
		};
		fdt@8 {
			description = "imx6q-edm_tc0700";
			data = /incbin/("./dtb/imx6q-edm1-cf-pmic_tc0700.dtb");
			type = "flat_dt";
			arch = "arm";
			compression = "none";
			load = <0x19E00000>;
			hash@1 {
				algo = "crc32";
			};
		};
		/* imx6qp */
		fdt@9 {
			description = "imx6qp-edm_fairy";
			data = /incbin/("./dtb/imx6qp-edm1-cf-pmic_fairy.dtb");
			type = "flat_dt";
			arch = "arm";
			compression = "none";
			load = <0x19E00000>;
			hash@1 {
				algo = "crc32";
			};
		};
		fdt@10 {
			description = "imx6qp-edm_tc1000";
			data = /incbin/("./dtb/imx6qp-edm1-cf-pmic_tc1000.dtb");
			type = "flat_dt";
			arch = "arm";
			compression = "none";
			load = <0x19E00000>;
			hash@1 {
				algo = "crc32";
			};
		};
		fdt@11 {
			description = "imx6qp-edm_tc1000_new-panel";
			data = /incbin/("./dtb/imx6qp-edm1-cf-pmic_tc1000_vxt101.dtb");
			type = "flat_dt";
			arch = "arm";
			compression = "none";
			load = <0x19E00000>;
			hash@1 {
				algo = "crc32";
			};
		};
		fdt@12 {
			description = "imx6qp-edm_tc0700";
			data = /incbin/("./dtb/imx6qp-edm1-cf-pmic_tc0700.dtb");
			type = "flat_dt";
			arch = "arm";
			compression = "none";
			load = <0x19E00000>;
			hash@1 {
				algo = "crc32";
			};
		};
	};

	configurations {
		default = "config@imx6dl_tc1000_vxt101";
		/* imx6dl */
		config@imx6dl_fairy {
			description = "EDM-FAIRY-IMX6DL";
			kernel = "kernel@1";
			ramdisk = "ramdisk@1";
			fdt = "fdt@1";
		};
		config@imx6dl_tc1000 {
			description = "EDM-TC1000-IMX6DL";
			kernel = "kernel@1";
			ramdisk = "ramdisk@1";
			fdt = "fdt@2";
		};
		config@imx6dl_tc1000_vxt101 {
			description = "EDM-TC1000_VXT101-IMX6DL";
			kernel = "kernel@1";
			ramdisk = "ramdisk@1";
			fdt = "fdt@3";
		};
		config@imx6dl_tc0700 {
			description = "EDM-TC0700-IMX6DL";
			kernel = "kernel@1";
			ramdisk = "ramdisk@1";
			fdt = "fdt@4";
		};
		/* imx6q */
		config@imx6q_fairy {
			description = "EDM-FAIRY-IMX6Q";
			kernel = "kernel@1";
			ramdisk = "ramdisk@1";
			fdt = "fdt@5";
		};
		config@imx6q_tc1000 {
			description = "EDM-TC1000-IMX6Q";
			kernel = "kernel@1";
			ramdisk = "ramdisk@1";
			fdt = "fdt@6";
		};
		config@imx6q_tc1000_vxt101 {
			description = "EDM-TC1000_VXT101-IMX6Q";
			kernel = "kernel@1";
			ramdisk = "ramdisk@1";
			fdt = "fdt@7";
		};
		config@imx6q_tc0700 {
			description = "EDM-TC0700-IMX6Q";
			kernel = "kernel@1";
			ramdisk = "ramdisk@1";
			fdt = "fdt@8";
		};
		/* imx6qp */
		config@imx6qp_fairy {
			description = "EDM-FAIRY-IMX6QP";
			kernel = "kernel@1";
			ramdisk = "ramdisk@1";
			fdt = "fdt@9";
		};
		config@imx6qp_tc1000 {
			description = "EDM-TC1000-IMX6QP";
			kernel = "kernel@1";
			ramdisk = "ramdisk@1";
			fdt = "fdt@10";
		};
		config@imx6qp_tc1000_vxt101 {
			description = "EDM-TC1000_VXT101-IMX6QP";
			kernel = "kernel@1";
			ramdisk = "ramdisk@1";
			fdt = "fdt@11";
		};
		config@imx6qp_tc0700 {
			description = "EDM-TC0700-IMX6QP";
			kernel = "kernel@1";
			ramdisk = "ramdisk@1";
			fdt = "fdt@12";
		};
	};
};
```

## board/wandboard/wand-pi-8m/Kconfig
```kconfig
if TARGET_WAND_PI_8M

config SYS_BOARD
	default "wand-pi-8m"

config SYS_VENDOR
	default "wandboard"

config SYS_CONFIG_NAME
	default "wand-pi-8m"

endif
```

## configs/edm-cf-imx6-no-console_defconfig
```kconfig
CONFIG_SPL=y
CONFIG_SYS_EXTRA_OPTIONS="IMX_CONFIG=arch/arm/imx-common/spl_sd.cfg,MX6QDL,SILENT_CONSOLE"
CONFIG_ARM=y
CONFIG_TARGET_EDM_CF_IMX6=y
CONFIG_DM=y
CONFIG_DM_THERMAL=y
CONFIG_ARCH_MX6=y
```

## configs/edm-cf-imx6_defconfig
```kconfig
CONFIG_SPL=y
CONFIG_SYS_EXTRA_OPTIONS="IMX_CONFIG=board/technexion/edm-cf-imx6/edm-cf-imx6.cfg,MX6QDL"
+S:CONFIG_ARM=y
+S:CONFIG_TARGET_EDM_CF_IMX6=y
```

## configs/edm1-imx6ul-nand_defconfig
```kconfig
CONFIG_SYS_EXTRA_OPTIONS="IMX_CONFIG=arch/arm/imx-common/spl_nand.cfg,MX6UL,SYS_BOOT_NAND"
CONFIG_ARM=y
CONFIG_ARCH_MX6=y
CONFIG_SPL=y
CONFIG_TARGET_EDM1_IMX6UL_NAND=y
```

## configs/edm1-imx7d_spl_defconfig
```kconfig
CONFIG_SYS_EXTRA_OPTIONS="IMX_CONFIG=arch/arm/imx-common/spl_sd.cfg,MX7D"
CONFIG_ARM=y
CONFIG_ARCH_MX7=y
CONFIG_TARGET_EDM1_IMX7D=y
CONFIG_SPL=y
CONFIG_DM=y
CONFIG_DM_THERMAL=y
CONFIG_IMX_RDC=y
CONFIG_IMX_BOOTAUX=y
```

## configs/pico-imx6dl_defconfig
```kconfig
CONFIG_ARM=y
CONFIG_ARCH_MX6=y
CONFIG_TARGET_PICO_IMX6=y
CONFIG_SYS_EXTRA_OPTIONS="IMX_CONFIG=board/technexion/pico-imx6/pico-imx6dl.cfg,MX6QDL"
CONFIG_DM=y
CONFIG_DM_THERMAL=y
```

## configs/pico-imx6ul-nand_defconfig
```kconfig
CONFIG_SYS_EXTRA_OPTIONS="IMX_CONFIG=arch/arm/imx-common/spl_nand.cfg,MX6UL,SYS_BOOT_NAND"
CONFIG_ARM=y
CONFIG_ARCH_MX6=y
CONFIG_SPL=y
CONFIG_TARGET_PICO_IMX6UL_NAND=y
```

## configs/pico-imx7d_spl_defconfig
```kconfig
CONFIG_ARM=y
CONFIG_ARCH_MX7=y
CONFIG_SPL_GPIO_SUPPORT=y
CONFIG_SPL_LIBCOMMON_SUPPORT=y
CONFIG_SPL_LIBGENERIC_SUPPORT=y
CONFIG_TARGET_PICO_IMX7D=y
CONFIG_SPL_MMC_SUPPORT=y
CONFIG_SPL_SERIAL_SUPPORT=y
CONFIG_SPL_LIBDISK_SUPPORT=y
CONFIG_SPL_FAT_SUPPORT=y
CONFIG_ARMV7_BOOT_SEC_DEFAULT=y
CONFIG_IMX_RDC=y
CONFIG_IMX_BOOTAUX=y
CONFIG_VIDEO=y
CONFIG_OF_BOARD_SETUP=y
CONFIG_SYS_EXTRA_OPTIONS="IMX_CONFIG=arch/arm/imx-common/spl_sd.cfg,MX7D"
CONFIG_BOOTDELAY=1
CONFIG_SPL=y
CONFIG_SPL_I2C_SUPPORT=y
CONFIG_HUSH_PARSER=y
CONFIG_CMD_BOOTZ=y
# CONFIG_CMD_IMLS is not set
# CONFIG_CMD_FLASH is not set
CONFIG_CMD_MMC=y
CONFIG_CMD_USB=y
CONFIG_CMD_GPIO=y
CONFIG_CMD_DHCP=y
CONFIG_CMD_MII=y
CONFIG_CMD_PING=y
CONFIG_CMD_CACHE=y
CONFIG_CMD_FAT=y
CONFIG_CMD_FS_GENERIC=y
CONFIG_IMX_THERMAL=y
CONFIG_USB=y
CONFIG_USB_STORAGE=y
CONFIG_OF_LIBFDT=y
```
