## configs/picosom-imx6_defconfig
```kconfig
CONFIG_SPL=y
CONFIG_SYS_EXTRA_OPTIONS="IMX_CONFIG=board/technexion/picosom-imx6/picosom-imx6.cfg,MX6QDL"
+S:CONFIG_ARM=y
+S:CONFIG_TARGET_PICOSOM_IMX6=y
```

## configs/picosom-imx6ul-no-console_spl_defconfig
```kconfig
CONFIG_SYS_EXTRA_OPTIONS="IMX_CONFIG=arch/arm/imx-common/spl_sd.cfg,MX6UL,SILENT_CONSOLE"
CONFIG_ARM=y
CONFIG_ARCH_MX6=y
CONFIG_TARGET_PICOSOM_IMX6UL=y
CONFIG_SPL=y
CONFIG_DM=y
CONFIG_DM_THERMAL=y
```

## configs/tek3-imx6ul_defconfig
```kconfig
CONFIG_SYS_EXTRA_OPTIONS="IMX_CONFIG=arch/arm/imx-common/spl_sd.cfg,MX6UL"
CONFIG_ARM=y
CONFIG_ARCH_MX6=y
CONFIG_TARGET_TEK3_IMX6UL=y
CONFIG_SPL=y
CONFIG_DM=y
CONFIG_DM_THERMAL=y
```

## configs/tep1-imx6ul_defconfig
```kconfig
CONFIG_SYS_EXTRA_OPTIONS="IMX_CONFIG=board/technexion/tep1-imx6ul/imximage.cfg,MX6UL"
CONFIG_ARM=y
CONFIG_ARCH_MX6=y
CONFIG_TARGET_TEP1_IMX6UL=y
CONFIG_SPL=y
CONFIG_DM=y
CONFIG_DM_THERMAL=y
```

## configs/wandboard_spl_defconfig
```kconfig
CONFIG_SPL=y
CONFIG_SYS_EXTRA_OPTIONS="IMX_CONFIG=board/wandboard/wandboard.cfg,MX6QDL"
+S:CONFIG_ARM=y
+S:CONFIG_TARGET_WANDBOARD=y
```
